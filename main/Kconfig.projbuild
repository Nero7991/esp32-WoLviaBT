## main/Kconfig.projbuild
```kconfig
menu "WoL via BT"

    config WOL_TARGET_MAC
        string "MAC address of the machine to wake"
        default "00:00:00:00:00:00"
        help
            Default wired MAC of the machine to wake, as aa:bb:cc:dd:ee:ff. A MAC set at
            runtime with POST /wol?mac=... is stored in NVS and takes precedence.

endmenu

menu "OTA"

    config OTA_USER
        string "HTTP Basic user for POST /ota"
        default "admin"

    config OTA_PASSWORD
        string "HTTP Basic password for POST /ota"
        default ""
        help
            Set it in sdkconfig.local (gitignored), not here. When empty, /ota is not
            registered and the board can only be updated over serial.

    config OTA_SELFTEST_TIMEOUT_MS
        int "Self-test window for a new image (ms)"
        default 120000
        help
            A freshly updated image must get an IP address within this window or it is
            rolled back to the previous image.

endmenu
```
